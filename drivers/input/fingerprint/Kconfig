## drivers/input/fingerprint/Kconfig
```kconfig
config FINGERPRINT_FPC1020
	bool "FPC1020 Driver"
	help
	  This driver supports FPC1020 fingerprint sensor.
```

## drivers/input/touchscreen/sec_ts/Kconfig
```kconfig
#
# Samsung Electronics TOUCH driver configuration
#

config TOUCHSCREEN_SEC_TS
        tristate "Samsung Electronics Touchscreen"
        depends on I2C
        help
          Say Y here if you want support for SEC touchscreen controllers.
          If unsure, say N.

          To compile this driver as a module, choose M here: the
          module will be called sec_ts.

config SEC_TS_WAKE_GESTURES
	bool "dt2w for samsung electronics touchscreen"
```

## drivers/platform/gm/Kconfig
```kconfig
config MACH_GM_GM9PRO_SPROUT
	bool "GM 9 Pro device"
	depends on ARCH_QCOM
	help
	  Support for GM 9 Pro product
```

## sound/soc/codecs/tfa98xx/Kconfig
```kconfig
config SND_SOC_TFA98XX
	tristate "TFA98XX smart amplifier support"
	depends on I2C
	depends on LEDS_CLASS
	help
	  The TFA98xx is a DSP controlled smart amplifier that can generate
	  waveforms and process a wide range of vibration effects.

	  To compile this driver as a module, choose M here: the
	  module will be called snd_soc_tfa98xx.
```
