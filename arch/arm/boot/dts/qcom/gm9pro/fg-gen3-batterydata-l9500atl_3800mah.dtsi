/* Copyright (c) 2018-2020, The Linux Foundation. All rights reserved.
 *
 * This program is free software; you can redistribute it and/or modify
 * it under the terms of the GNU General Public License version 2 and
 * only version 2 as published by the Free Software Foundation.
 *
 * This program is distributed in the hope that it will be useful,
 * but WITHOUT ANY WARRANTY; without even the implied warranty of
 * MERCHANTABILITY or FITNESS FOR A PARTICULAR PURPOSE.  See the
 * GNU General Public License for more details.
 */

qcom,l9500atl_3800mah {
	/* #l9500atl_3800mah_averaged_masterslave*/
	qcom,max-voltage-uv = <4400000>;
	qcom,fastchg-current-ma = <3000>;
	qcom,nom-batt-capacity-mah = <3800>;
	qcom,batt-id-kohm = <100>;
	qcom,battery-beta = <3380>;
	qcom,fg-cc-cv-threshold-mv = <4390>;
	qcom,battery-full-design = <3800>;
	qcom,battery-type = "l9500atl_3800mah_averaged_masterslave_jan15th2018";
	qcom,checksum = <0x59C6>;
	qcom,gui-version = "PM660GUI - 0.0.0.45";
	qcom,fg-profile-data = [
		 2A 1F 22 06
		 FF 03 D7 06
		 E7 1C DD 01
		 E6 0D 6C 0A
		 C4 17 DB 23
		 5D 44 59 5A
		 74 00 00 00
		 10 00 00 00
		 00 00 EB CC
		 B3 C4 29 D2
		 21 00 08 00
		 9A CA B4 E5
		 B8 06 B1 00
		 A7 F3 CE 0B
		 B2 06 2D 2B
		 1B 06 09 20
		 27 00 14 00
		 F0 1F 54 05
		 A5 0A 2C 06
		 CB 1C DF 02
		 23 0C 18 12
		 8B 18 D3 23
		 E8 4D 2D 5B
		 6D 00 00 00
		 0E 00 00 00
		 00 00 F3 D5
		 5B C3 06 BB
		 1B 00 00 00
		 24 EA B4 E5
		 17 07 DD EB
		 4E E2 24 03
		 E7 F4 63 1A
		 99 33 CC FF
		 07 10 00 00
		 D5 0E 66 46
		 1B 00 40 00
		 65 01 0A FA
		 ff 00 00 00
		 00 00 00 00
		 00 00 00 00
		 00 00 00 00
		 00 00 00 00
		 00 00 00 00
		 00 00 00 00
		 00 00 00 00
		 00 00 00 00
		 00 00 00 00
		 00 00 00 00
		 00 00 00 00
		 00 00 00 00
		 00 00 00 00
		 00 00 00 00
		 00 00 00 00
		 00 00 00 00
		 00 00 00 00
		 00 00 00 00
	];
};
