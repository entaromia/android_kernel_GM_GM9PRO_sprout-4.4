/* Copyright (c) 2019, The Linux Foundation. All rights reserved.
 *
 * This program is free software; you can redistribute it and/or modify
 * it under the terms of the GNU General Public License version 2 and
 * only version 2 as published by the Free Software Foundation.
 *
 * This program is distributed in the hope that it will be useful,
 * but WITHOUT ANY WARRANTY; without even the implied warranty of
 * MERCHANTABILITY or FITNESS FOR A PARTICULAR PURPOSE.  See the
 * GNU General Public License for more details.
 */

/* msm-pm660l.dtsi common diff */

&green_led {
	qcom,start-idx = <0>;
	qcom,idx-len = <22>;
	qcom,duty-pcts =
		[01 0a 14 1e 28 32 3c 46 50 5a 64
		64 5a 50 46 3c 32 28 1e 14 0a 01];
	qcom,use-blink;
};

&blue_led {
	qcom,start-idx = <0>;
	qcom,idx-len = <22>;
	qcom,duty-pcts =
		[01 0a 14 1e 28 32 3c 46 50 5a 64
		64 5a 50 46 3c 32 28 1e 14 0a 01];
	qcom,use-blink;
};
